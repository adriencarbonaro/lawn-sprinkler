## main/Kconfig.projbuild
```kconfig
menu "Lawn Sprinkler Controller Settings"

# Wifi configuration -----------------------------------------------------------

config WIFI_SSID
    string "WiFi SSID"

config WIFI_PASSWORD
    string "WiFi Password"

# MQTT configuration -----------------------------------------------------------

config MQTT_URI
    string "MQTT Uri (format: mqtt://[USER]:[PASSWORD]@[HOST]:[PORT])"

config MQTT_TOPIC_PREFIX
    string "MQTT topic prefix (must end with '/')"
    default "lawn-sprinkler/"

# Device identity --------------------------------------------------------------

config DEVICE_ID
    string "Device ID (used in HA discovery unique ids)"
    default "lawn_sprinkler"

config DEVICE_NAME
    string "Device friendly name"
    default "Lawn Sprinkler"

config ESP32_MODEL
    string "ESP32 chip model"
    default "ESP32"

config MANUFACTURER
    string "Manufacturer"
    default "Carbonaro"

# Time -------------------------------------------------------------------------

config NTP_SERVER
    string "NTP server"
    default "pool.ntp.org"

config NTP_TZ
    string "POSIX timezone string"
    default "CET-1CEST,M3.5.0/2,M10.5.0/3"

# Sprinkler specific
config DEFAULT_DURATION_SEC
    int "Default watering duration applied to a button press (seconds, 0 = no auto-stop)"
    default 600

config AUTO_MODE_RESET_TIME_MIN
    int "Timer before going back to AUTO mode if idle in MANUAL mode"
    default 30

# GPIO -------------------------------------------------------------------------

config GPIO_BTN_ZONE_1
    int "Button GPIO (zone 1)"
    default 4

config GPIO_BTN_ZONE_2
    int "Button GPIO (zone 2)"
    default 5

config GPIO_BTN_ZONE_3
    int "Button GPIO (zone 3)"
    default 6

config GPIO_BTN_ZONE_4
    int "Button GPIO (zone 4)"
    default 7

config GPIO_BTN_ZONE_5
    int "Button GPIO (zone 5)"
    default 8

config GPIO_BTN_ZONE_6
    int "Button GPIO (zone 6)"
    default 9

config GPIO_ZONE_1
    int "Zone GPIO (zone 1)"
    default 18

config GPIO_ZONE_2
    int "Zone GPIO (zone 2)"
    default 19

config GPIO_ZONE_3
    int "Zone GPIO (zone 3)"
    default 20

config GPIO_ZONE_4
    int "Zone GPIO (zone 4)"
    default 21

config GPIO_ZONE_5
    int "Zone GPIO (zone 5)"
    default 22

config GPIO_ZONE_6
    int "Zone GPIO (zone 6)"
    default 23

endmenu
```
